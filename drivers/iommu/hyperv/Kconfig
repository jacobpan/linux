## drivers/iommu/hyperv/Kconfig
```kconfig
# SPDX-License-Identifier: GPL-2.0-only
# Hyper-V para-virtualized IOMMU driver for Linux guests
config HYPERV_PVIOMMU
	bool "Microsoft Hyper-V para-virtualized IOMMU driver for Linux guests"
	depends on X86_64 && HYPERV && PCI
	select IOMMU_DMA
	select GENERIC_PT
	select IOMMU_PT
	select IOMMU_PT_X86_64
	default HYPERV
	help
	  Para-virtualized IOMMU driver for Linux guests running on
	  Microsoft Hyper-V. Provides DMA remapping and IOTLB
	  flush support to enable DMA isolation for PCI devices
	  assigned to the guest.

config HYPERV_ROOT_IOMMU
	bool "Hyper-V IOMMU Device in root partition"
	depends on HYPERV && X86 && PCI_MSI && MSHV_ROOT
	select IOMMU_API
	default HYPERV
	help
	  This enables Hyper-V pseudo IOMMU device. When running as privileged
	  VM aka root on Microsoft Hyper-V hypervisor, this must be enabled
	  for doing any PCI passthru of devices to guest VMs. This applies to
	  both PFs and VFs. When enabling this, it is best to disable amd/intel
	  iommus via: intel_iommu=off amd_iommu=off as the hypervisor really
	  owns the iommu.
```
